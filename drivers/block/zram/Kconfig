## drivers/block/zram/Kconfig
```kconfig
# SPDX-License-Identifier: GPL-2.0
config ZRAM
	tristate "Compressed RAM block device support"
	depends on BLOCK && SYSFS && MMU
	select ZSMALLOC
	select CRYPTO_LZO
	select CRYPTO_LZO_RLE
	select CRYPTO_LZ4
	select CRYPTO_LZ4KD
	default n
	help
	  Creates virtual block devices called /dev/zramX (X = 0, 1, ...).
	  Pages written to these disks are compressed and stored in memory
	  itself. These disks allow very fast I/O and compression provides
	  good amounts of memory savings.

	  See Documentation/blockdev/zram.txt for more information.

choice
	prompt "Default zram compressor"
	default ZRAM_DEF_COMP_LZ4KD
	depends on ZRAM

config ZRAM_DEF_COMP_LZORLE
	bool "lzo-rle"
	depends on CRYPTO_LZO_RLE

config ZRAM_DEF_COMP_ZSTD
	bool "zstd"
	depends on CRYPTO_ZSTD

config ZRAM_DEF_COMP_LZ4
	bool "lz4"
	depends on CRYPTO_LZ4

config ZRAM_DEF_COMP_LZ4KD
	bool "lz4kd"
	depends on CRYPTO_LZ4KD

config ZRAM_DEF_COMP_DEFLATE
	bool "deflate"
	depends on CRYPTO_DEFLATE

config ZRAM_DEF_COMP_LZO
	bool "lzo"
	depends on CRYPTO_LZO

config ZRAM_DEF_COMP_LZ4HC
	bool "lz4hc"
	depends on CRYPTO_LZ4HC

config ZRAM_DEF_COMP_842
	bool "842"
	depends on CRYPTO_842

endchoice

config ZRAM_DEF_COMP
	string
	default "lzo-rle" if ZRAM_DEF_COMP_LZORLE
	default "zstd" if ZRAM_DEF_COMP_ZSTD
	default "lz4" if ZRAM_DEF_COMP_LZ4
	default "lz4kd" if ZRAM_DEF_COMP_LZ4KD
	default "deflate" if ZRAM_DEF_COMP_DEFLATE
	default "lzo" if ZRAM_DEF_COMP_LZO
	default "lz4hc" if ZRAM_DEF_COMP_LZ4HC
	default "842" if ZRAM_DEF_COMP_842

config ZRAM_DEDUP
	bool "Deduplication support for ZRAM data"
	depends on ZRAM
	default n

config ZRAM_WRITEBACK
       bool "Write back incompressible or idle page to backing device"
       depends on ZRAM
       default n

config ZRAM_MEMORY_TRACKING
	bool "Track zRam block status"
	depends on ZRAM && DEBUG_FS

config MIUI_ZRAM_MEMORY_TRACKING
	bool "Track zRam stats"
	depends on ZRAM
	
```

## drivers/xiaomi/Kconfig
```kconfig
config XIAOMI_MIUI
	bool "Enable Xiaomi MIUI modifications"
	depends on BOARD_XIAOMI
	help
	  Enables compilation of Xiaomi MIUI specific vendor additions

	  [span_2](start_span)Say Y if you want to compile the Xiaomi MIUI specific kernel modifications.[span_2](end_span)
	  [span_3](start_span)Say N if you want to discard the Xiaomi MIUI specific kernel modifications.[span_3](end_span)

if XIAOMI_MIUI

config PACKAGE_RUNTIME_INFO
	bool "Show package runtime info on cluster"
	help
	  [span_4](start_span)This option can show package runtime info in sup/big/little core.[span_4](end_span)

config MIGT
	bool "Boost cpufreq during high load"
	depends on PACKAGE_RUNTIME_INFO
	help
	  [span_5](start_span)Boost cpufreq when current frame drawing time too long[span_5](end_span)

config MILLET
	bool "MIUI frozen framework"
	depends on PACKAGE_RUNTIME_INFO
	help
	  [span_6](start_span)MIUI frozen function[span_6](end_span)

config MIGT_ENERGY_MODEL
	bool "DT-based Energy Model for CPU and GPU"
	depends on MIGT
	help
	  This mod rely on Energy Models (EMs) statically defined in
	  [span_7](start_span)the Device Tree.[span_7](end_span)

config PERF_HUMANTASK
	bool "Enable MIUI humantask performance feature"
	help
	  [span_8](start_span)This option adds support to switch on/off the sched humantask.[span_8](end_span)

config PERF_CRITICAL_RT_TASK
	bool "Enable set rt binder thread" if EXPERT
	help
	  This option speeds ui feature by setting BlastBufferQueue binder
	  [span_9](start_span)thread to FIFO.[span_9](end_span)

config SF_BINDER
	bool "Enable surfaceflinger binder thread" if EXPERT
	help
	  [span_10](start_span)Xiaomi restore surfaceflinger binder priority FIFO[span_10](end_span)

config MIUI_ZRAM_MEMORY_TRACKING
	bool "Track zRam stats"
	depends on ZRAM
	help
	  With this feature, admin can track the state of zram via
	  [span_11](start_span)/sys/block/zramX/.[span_11](end_span)

source "drivers/xiaomi/fragmention/Kconfig"

endif
```
